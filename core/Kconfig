## core/Kconfig
```kconfig
# SPDX-License-Identifier: GPL-2.0
config GREETINGS
	string "Greeting string"
	default "Hello!"
	help
	  Your greeting strings here.

config EXTRA_MESSAGE
	bool "Print extra messages"
	default y
	help
	  Print messages in all log levels.
```

## init/Kconfig.debug
```kconfig
# SPDX-License-Identifier: GPL-2.0-only
menu "Compiler optimize and debug options"

config DEBUG_SECTION_MISMATCH
		bool "Enable full Section mismatch analysis"
		help
		  The section mismatch analysis checks if there are illegal
		  references from one section to another section.
		  During linktime or runtime, some sections are dropped;
		  any use of code/data previously in these sections would
		  most likely result in an oops.
		  In the code, functions and variables are annotated with
		  __init,, etc. (see the full list in include/linux/init.h),
		  which results in the code/data being placed in specific sections.
		  The section mismatch analysis is always performed after a full
		  kernel build, and enabling this option causes the following
		  additional step to occur:
		  - Add the option -fno-inline-functions-called-once to gcc commands.
			When inlining a function annotated with __init in a non-init
			function, we would lose the section information and thus
			the analysis would not catch the illegal reference.
			This option tells gcc to inline less (but it does result in
			a larger kernel).

config STRIP_ASM_SYMS
		bool "Strip assembler-generated symbols during link"
		default n
		help
		  Strip internal assembler-generated symbols during a link (symbols
		  that look like '.Lxxx') so they don't pollute the output of
		  get_wchan() and suchlike.

choice
		prompt "Optimization level"
		default CC_OPTIMIZE_FOR_PERFORMANCE

config CC_OPTIMIZE_FOR_DEBUG
		bool "Optimize for debug (-O0)"
		help
		  Choosing this option will pass "-O0" to your compiler resulting
		  no compiler optimization.

config CC_OPTIMIZE_FOR_PERFORMANCE
		bool "Optimize for performance (-O2)"
		help
		  This is the default optimization level for the kernel, building
		  with the "-O2" compiler flag for best performance and most
		  helpful compile-time warnings.

config CC_OPTIMIZE_FOR_PERFORMANCE_O3
		bool "Optimize more for performance (-O3)"
		help
		  Choosing this option will pass "-O3" to your compiler to optimize
		  the kernel yet more for performance.

config CC_OPTIMIZE_FOR_SIZE
		bool "Optimize for size (-Os)"
		help
		  Choosing this option will pass "-Os" to your compiler resulting
		  in a smaller kernel.

endchoice

config DEBUG_INFO
		bool "Compile with debug info"
		help
		  If you say Y here the resulting kernel image will include
		  debugging info resulting in a larger kernel image.
		  This adds debug symbols to the kernel and modules (gcc -g), and
		  is needed if you intend to use kernel crashdump or binary object
		  tools like crash, kgdb, LKCD, gdb, etc on the kernel.
		  Say Y here only if you plan to debug the kernel.

		  If unsure, say N.

config DEBUG_INFO_REDUCED
		bool "Reduce debugging information"
		depends on DEBUG_INFO
		help
		  If you say Y here gcc is instructed to generate less debugging
		  information for structure types. This means that tools that
		  need full debugging information (like kgdb or systemtap) won't
		  be happy. But if you merely need debugging information to
		  resolve line numbers there is no loss. Advantage is that
		  build directory object sizes shrink dramatically over a full
		  DEBUG_INFO build and compile times are reduced too.
		  Only works with newer gcc versions.

config DEBUG_INFO_SPLIT
		bool "Produce split debuginfo in .dwo files"
		depends on DEBUG_INFO
		depends on $(cc-option,-gsplit-dwarf)
		help
		  Generate debug info into separate .dwo files. This significantly
		  reduces the build directory size for builds with DEBUG_INFO,
		  because it stores the information only once on disk in .dwo
		  files instead of multiple times in object files and executables.
		  In addition the debug information is also compressed.

		  Requires recent gcc (4.7+) and recent gdb/binutils.
		  Any tool that packages or reads debug information would need
		  to know about the .dwo files and include them.
		  Incompatible with older versions of ccache.

config DEBUG_INFO_DWARF4
		bool "Generate dwarf4 debuginfo"
		depends on DEBUG_INFO
		depends on $(cc-option,-gdwarf-4)
		help
		  Generate dwarf4 debug info. This requires recent versions
		  of gcc and gdb. It makes the debug information larger.
		  But it significantly improves the success of resolving
		  variables in gdb on optimized code.

config READABLE_ASM
		bool "Generate readable assembler code"
		depends on DEBUG_INFO
		default y
		help
		  Disable some compiler optimizations that tend to generate human unreadable
		  assembler output. This may make the kernel slightly slower, but it helps
		  to keep kernel developers who have to stare a lot at assembler listings
		  sane.

config FRAME_POINTER
		bool "Compile the kernel with frame pointers"
		depends on DEBUG_INFO
		default y
		help
		  If you say Y here the resulting kernel image will be slightly
		  larger and slower, but it gives very useful debugging information
		  in case of kernel bugs. (precise oopses/stacktraces/warnings)

endmenu
```

## lib/Kconfig
```kconfig
# SPDX-License-Identifier: GPL-2.0
config SHOW_LOG_LEVEL
	bool "Show log level message"
	default y
	help
	  Print extra information of current log message.

config MULTIPLE_LOG_LEVELS
	bool "Use different log levels"
	default y

config LOG_INFO
	bool "Enable info log messages"
	default n
	depends on MULTIPLE_LOG_LEVELS

config LOG_WARNING
	bool "Enable warning log messages"
	default n
	depends on MULTIPLE_LOG_LEVELS

config LOG_ERROR
	bool "Enable error log messages"
	default y
	depends on MULTIPLE_LOG_LEVELS
```
